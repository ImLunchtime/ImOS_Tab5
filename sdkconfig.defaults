## sdkconfig.defaults
```kconfig
#
# Audio Player Configuration
#
CONFIG_AUDIO_PLAYER_ENABLE_MP3=y
CONFIG_AUDIO_PLAYER_ENABLE_WAV=y
CONFIG_AUDIO_PLAYER_LOG_LEVEL=3
```

## sdkconfig.defaults.esp32p4
```kconfig
CONFIG_IDF_TARGET="esp32p4"
CONFIG_ESPTOOLPY_FLASHMODE_QIO=y
CONFIG_ESPTOOLPY_FLASHSIZE_16MB=y
CONFIG_PARTITION_TABLE_CUSTOM=y
CONFIG_COMPILER_OPTIMIZATION_PERF=y
CONFIG_SPIRAM=y
CONFIG_SPIRAM_SPEED_200M=y
CONFIG_SPIRAM_XIP_FROM_PSRAM=y
CONFIG_CACHE_L2_CACHE_256KB=y
CONFIG_CACHE_L2_CACHE_LINE_128B=y
CONFIG_FREERTOS_HZ=1000
CONFIG_FREERTOS_VTASKLIST_INCLUDE_COREID=y
CONFIG_FREERTOS_GENERATE_RUN_TIME_STATS=y
CONFIG_ESP_BROOKESIA_MEMORY_USE_CUSTOM=y
CONFIG_LV_COLOR_SCREEN_TRANSP=y
CONFIG_LV_MEM_CUSTOM=y
CONFIG_LV_MEMCPY_MEMSET_STD=y
CONFIG_LV_DISP_DEF_REFR_PERIOD=25
CONFIG_LV_USE_LOG=y
CONFIG_LV_LOG_PRINTF=y
CONFIG_LV_USE_PERF_MONITOR=y
CONFIG_LV_ATTRIBUTE_FAST_MEM_USE_IRAM=y
CONFIG_LV_FONT_MONTSERRAT_8=y
CONFIG_LV_FONT_MONTSERRAT_10=y
CONFIG_LV_FONT_MONTSERRAT_12=y
CONFIG_LV_FONT_MONTSERRAT_16=y
CONFIG_LV_FONT_MONTSERRAT_18=y
CONFIG_LV_FONT_MONTSERRAT_20=y
CONFIG_LV_FONT_MONTSERRAT_22=y
CONFIG_LV_FONT_MONTSERRAT_24=y
CONFIG_LV_FONT_MONTSERRAT_26=y
CONFIG_LV_FONT_MONTSERRAT_28=y
CONFIG_LV_FONT_MONTSERRAT_30=y
CONFIG_LV_FONT_MONTSERRAT_32=y
CONFIG_LV_FONT_MONTSERRAT_34=y
CONFIG_LV_FONT_MONTSERRAT_36=y
CONFIG_LV_FONT_MONTSERRAT_38=y
CONFIG_LV_FONT_MONTSERRAT_40=y
CONFIG_LV_FONT_MONTSERRAT_42=y
CONFIG_LV_FONT_MONTSERRAT_44=y
CONFIG_LV_FONT_FMT_TXT_LARGE=y
CONFIG_LV_USE_FONT_COMPRESSED=y
CONFIG_LV_USE_DEMO_BENCHMARK=y
CONFIG_IDF_EXPERIMENTAL_FEATURES=y
CONFIG_CODEC_I2C_BACKWARD_COMPATIBLE=n




CONFIG_ESP_HOSTED_ENABLED=y

#
# ESP-Hosted config
#

#
# ESP32-C6 is Slave Target from Wi-Fi Remote Component
#
CONFIG_ESP_HOSTED_PRIV_SDIO_OPTION=y
CONFIG_ESP_HOSTED_PRIV_SPI_HD_OPTION=y
# CONFIG_ESP_HOSTED_SPI_HOST_INTERFACE is not set
CONFIG_ESP_HOSTED_SDIO_HOST_INTERFACE=y
# CONFIG_ESP_HOSTED_SPI_HD_HOST_INTERFACE is not set
# CONFIG_ESP_HOSTED_UART_HOST_INTERFACE is not set
CONFIG_ESP_HOSTED_IDF_SLAVE_TARGET="esp32c6"

#
# Hosted SDIO Configuration
#
# CONFIG_ESP_HOSTED_SDIO_RESET_ACTIVE_HIGH is not set
CONFIG_ESP_HOSTED_SDIO_RESET_ACTIVE_LOW=y
# CONFIG_ESP_HOSTED_SDIO_OPTIMIZATION_RX_NONE is not set
# CONFIG_ESP_HOSTED_SDIO_OPTIMIZATION_RX_MAX_SIZE is not set
CONFIG_ESP_HOSTED_SDIO_OPTIMIZATION_RX_STREAMING_MODE=y
CONFIG_ESP_HOSTED_SDIO_GPIO_RESET_SLAVE=15
CONFIG_ESP_HOSTED_SDIO_4_BIT_BUS=y
# CONFIG_ESP_HOSTED_SDIO_1_BIT_BUS is not set
CONFIG_ESP_HOSTED_SDIO_BUS_WIDTH=4
CONFIG_ESP_HOSTED_SDIO_CLOCK_FREQ_KHZ=40000
CONFIG_ESP_HOSTED_SDIO_PIN_CMD=13
CONFIG_ESP_HOSTED_SDIO_PIN_CLK=12
CONFIG_ESP_HOSTED_SDIO_PIN_D0=11
CONFIG_ESP_HOSTED_SDIO_PRIV_PIN_D1_4BIT_BUS=10
CONFIG_ESP_HOSTED_SDIO_PIN_D2=9
CONFIG_ESP_HOSTED_SDIO_PIN_D3=8
CONFIG_ESP_HOSTED_SDIO_PIN_D1=10
CONFIG_ESP_HOSTED_SDIO_TX_Q_SIZE=20
CONFIG_ESP_HOSTED_SDIO_RX_Q_SIZE=20
# CONFIG_ESP_HOSTED_SDIO_CHECKSUM is not set
# end of Hosted SDIO Configuration

CONFIG_ESP_HOSTED_GPIO_SLAVE_RESET_SLAVE=15
CONFIG_ESP_HOSTED_RESET_GPIO_ACTIVE_LOW=y



#
# Examples
#
CONFIG_LV_BUILD_EXAMPLES=y
# end of Examples

#
# Demos
#
CONFIG_LV_USE_DEMO_WIDGETS=y
CONFIG_LV_USE_DEMO_KEYPAD_AND_ENCODER=y
CONFIG_LV_USE_DEMO_BENCHMARK=y
# CONFIG_LV_USE_DEMO_RENDER is not set
# CONFIG_LV_USE_DEMO_SCROLL is not set
# CONFIG_LV_USE_DEMO_STRESS is not set
# CONFIG_LV_USE_DEMO_TRANSFORM is not set
CONFIG_LV_USE_DEMO_MUSIC=y
# CONFIG_LV_DEMO_MUSIC_SQUARE is not set
CONFIG_LV_DEMO_MUSIC_LANDSCAPE=y
# CONFIG_LV_DEMO_MUSIC_ROUND is not set
# CONFIG_LV_DEMO_MUSIC_LARGE is not set
# CONFIG_LV_DEMO_MUSIC_AUTO_PLAY is not set
# CONFIG_LV_USE_DEMO_FLEX_LAYOUT is not set
# CONFIG_LV_USE_DEMO_MULTILANG is not set
# end of Demos
# end of LVGL configuration
```
